## src/drivers/flex_sensor/Kconfig
```kconfig
menuconfig DRIVERS_FLEX_SENSOR
	bool "flex_sensor (Nitto/Bend Labs ADS I2C)"
	default n
	---help---
		Enable driver for Nitto/Bend Labs Angular Displacement Sensor (ADS)
		connected via I2C. Default address 0x13. Supports 1-axis and 2-axis
		sensors. Publishes flex_sensor uORB topic at 20 Hz.
```
